## config/boards/arm/particle_xenon_zmk/Kconfig.board
```kconfig
config BOARD_PARTICLE_XENON_ZMK
	bool "Particle Xenon"
	depends on BOARD_PARTICLE_XENON
```

## config/boards/arm/particle_xenon_zmk/Kconfig.defconfig
```kconfig
# Copyright (c) 2021 The ZMK Contributors
# SPDX-License-Identifier: MIT

if BOARD_PARTICLE_XENON_ZMK

config BOARD
	default "praticle_xenon_zmk"

if USB

config USB_NRFX
	default y

config USB_DEVICE_STACK
	default y

endif # USB

config BT_CTLR
	default BT

config ZMK_BLE
	default y

config ZMK_USB
	default y

endif
```

## config/boards/shields/dactyl_manuform/Kconfig.defconfig
```kconfig
# Copyright (c) 2020-2021 The ZMK Contributors
# SPDX-License-Identifier: MIT

if SHIELD_DACTYL_MANUFORM_LEFT || SHIELD_DACTYL_MANUFORM_RIGHT
# TODO: MOVE TO PARTICLE BOARD
### flash
config BUILD_OUTPUT_BIN
	bool
	default y

config BUILD_OUTPUT_UF2
	bool
	default y

config FLASH_LOAD_OFFSET
	default 0x26000

### usb
config ZMK_USB
	default y

config USB_NRFX
	default y

config USB_DEVICE_STACK
	default y


### split
if ZMK_BLE
config ZMK_SPLIT_BLE_ROLE_CENTRAL
    default n if SHIELD_DACTYL_MANUFORM_LEFT
    default y if SHIELD_DACTYL_MANUFORM_RIGHT
endif
config ZMK_KEYBOARD_NAME
    default "DactylLeft" if SHIELD_DACTYL_MANUFORM_LEFT
    default "DactylRight" if SHIELD_DACTYL_MANUFORM_RIGHT
endif
```

## config/boards/shields/dactyl_manuform/Kconfig.shield
```kconfig
# Copyright (c) 2020-2021 The ZMK Contributors
# SPDX-License-Identifier: MIT

config SHIELD_DACTYLMANUFORM_LEFT
	def_bool $(shields_list_contains,dactyl_manuform_left)

config SHIELD_DACTYLMANUFORM_RIGHT
	def_bool $(shields_list_contains,dactyl_manuform_right)
```

## config/boards/shields/new_split_concept/Kconfig.defconfig
```kconfig
# Copyright (c) 2020-2021 The ZMK Contributors
# SPDX-License-Identifier: MIT

if SHIELD_DACTYLMANUFORM
	
# TODO: MOVE TO PARTICLE BOARD
config BUILD_OUTPUT_UF2
	default y

# TODO: MOVE TO PARTICLE BOARD
config FLASH_LOAD_OFFSET 
	default 0x26000

config BT_CTLR
	default BT

config ZMK_BLE
	default y

config ZMK_USB
	default y

config USB_NRFX
	default y

config USB_DEVICE_STACK
	default y

# TODO: ADD SUPPORT FOR ZMK
# config ZMK_BATTERY_VOLTAGE_DIVIDER
# 	default y


### split 
config ZMK_SPLIT
	default y
	select ZMK_SPLIT_BLE

config ZMK_SPLIT_MAIN
	bool "If this is set then board is used as a main one. Left one should be flashed with main"
	default n
	select ZMK_SPLIT_BLE_ROLE_CENTRAL

config ZMK_KEYBOARD_NAME
    default "DactylManuMain" if ZMK_SPLIT_MAIN
    default "DactylManuSub" if !ZMK_SPLIT_MAIN

endif # SHIELD_DACTYLMANUFORM
```

## config/boards/shields/settings_reset_particle/Kconfig.defconfig
```kconfig
# Copyright (c) 2020 The ZMK Contributors
# SPDX-License-Identifier: MIT

if SHIELD_SETTINGS_RESET

config ZMK_KEYBOARD_NAME
	default "SETTINGS RESET PARTICLE"
config BUILD_OUTPUT_BIN
	bool
	default y

config BUILD_OUTPUT_UF2
	bool
	default y

config FLASH_LOAD_OFFSET
	default 0x26000
endif
```

## config/boards/shields/settings_reset_particle/Kconfig.shield
```kconfig
# Copyright (c) 2020 The ZMK Contributors
# SPDX-License-Identifier: MIT

config SHIELD_SETTINGS_RESET_PARTICLE
	def_bool $(shields_list_contains,settings_reset_particle)
```
